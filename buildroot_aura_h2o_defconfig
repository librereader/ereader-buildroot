## buildroot_aura_h2o_defconfig
```kconfig
BR2_arm=y
BR2_cortex_a8=y
BR2_OPTIMIZE_2=y
BR2_RELRO_FULL=y
BR2_TOOLCHAIN_BUILDROOT_MUSL=y
BR2_PACKAGE_HOST_LINUX_HEADERS_CUSTOM_REALLY_OLD=y
BR2_BINUTILS_VERSION_2_31_X=y
BR2_GCC_VERSION_4_9_X=y
BR2_TOOLCHAIN_BUILDROOT_CXX=y
BR2_GCC_ENABLE_LTO=y
BR2_TARGET_OPTIMIZATION="-mno-unaligned-access"
BR2_ROOTFS_DEVICE_TABLE_SUPPORTS_EXTENDED_ATTRIBUTES=y
BR2_TARGET_GENERIC_GETTY_PORT="ttymxc0"
BR2_SYSTEM_ENABLE_NLS=y
BR2_TARGET_TZ_INFO=y
BR2_GLOBAL_PATCH_DIR="$(TOPDIR)/../files/kobo-aura-h2o/patches"
BR2_LINUX_KERNEL=y
BR2_LINUX_KERNEL_CUSTOM_TARBALL=y
BR2_LINUX_KERNEL_CUSTOM_TARBALL_LOCATION="file://$(TOPDIR)/../archives/linux/linux-2.6.35.3.tar.xz"
BR2_LINUX_KERNEL_USE_CUSTOM_CONFIG=y
BR2_LINUX_KERNEL_CUSTOM_CONFIG_FILE="$(TOPDIR)/../files/kobo-aura-h2o/linux_defconfig"
BR2_LINUX_KERNEL_UIMAGE=y
BR2_PACKAGE_LIBERATION=y
BR2_PACKAGE_LINUX_FIRMWARE=y
BR2_PACKAGE_LINUX_FIRMWARE_BRCM_BCM43XXX=y
BR2_PACKAGE_ZLIB=y
BR2_PACKAGE_ZLIB_NG=y
BR2_PACKAGE_FREETYPE=y
BR2_PACKAGE_MXML=y
BR2_PACKAGE_LIBEV=y
BR2_PACKAGE_LIBPTHREAD_STUBS=y
BR2_PACKAGE_NCURSES=y
BR2_PACKAGE_XUTIL_UTIL_MACROS=y
BR2_PACKAGE_DROPBEAR=y
BR2_PACKAGE_DROPBEAR_DISABLE_REVERSEDNS=y
BR2_PACKAGE_IPUTILS=y
BR2_PACKAGE_WIRELESS_TOOLS=y
BR2_PACKAGE_WPA_SUPPLICANT=y
BR2_PACKAGE_WPA_SUPPLICANT_WPS=y
BR2_PACKAGE_WPA_SUPPLICANT_CLI=y
BR2_PACKAGE_WPA_SUPPLICANT_PASSPHRASE=y
BR2_PACKAGE_KMOD=y
BR2_PACKAGE_UTIL_LINUX=y
BR2_PACKAGE_UTIL_LINUX_LIBBLKID=y
BR2_TARGET_ROOTFS_EXT2=y
BR2_TARGET_ROOTFS_EXT2_4=y
BR2_TARGET_ROOTFS_EXT2_LABEL="root"
BR2_TARGET_ROOTFS_EXT2_SIZE="128M"
BR2_TARGET_ROOTFS_EXT2_MKFS_OPTIONS="-O ^64bit -O ^metadata_csum"
BR2_TARGET_ROOTFS_TAR_GZIP=y
```

## package/coolreader/Config.in
```kconfig
config BR2_PACKAGE_COOLREADER
	bool "coolreader"
	help
	  coolreader
	select BR2_PACKAGE_QT5BASE_GUI
	select BR2_PACKAGE_QT5BASE_WIDGETS
	select BR2_PACKAGE_QT5TOOLS
	select BR2_PACKAGE_QT5TOOLS_LINGUIST_TOOLS
```

## package/qt5/qt5einkfb/Config.in
```kconfig
config BR2_PACKAGE_QT5EINKFB
	bool "qt5einkfb"
	help
	  Qt is a cross-platform application and UI framework for
	  developers using C++.

	  This package corresponds to the framebuffer QPA platform
	  plugin for E-Readers and E-Ink devices.
```
